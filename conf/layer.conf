## conf/layer.conf
```bitbake
BBPATH .= ":${LAYERDIR}"

BBFILES += "${LAYERDIR}/recipes-*/*/*.bb ${LAYERDIR}/recipes-*/*/*.bbappend"
BBFILE_COLLECTIONS += "air-quality"
BBFILE_PATTERN_air-quality = "^${LAYERDIR}/"
BBFILE_PRIORITY_air-quality = "10"
LAYERVERSION_air-quality = "1"
LAYERDEPENDS_air-quality = " \
    core \
    openembedded-layer \
    raspberrypi \
    "

LAYERSERIES_COMPAT_air-quality = "kirkstone"
```
